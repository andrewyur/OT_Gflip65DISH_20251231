## drivers/misc/mediatek/sensors-1.0/accelerometer/stk8baxx/Kconfig
```kconfig
config MTK_STK8BAXX_I2C
	bool "MTK_STK8BAXX for MediaTek package"
	default n
	help
	  The stk8baxx is a highly integrated,
	  low power internal measurement unit
	  that provides precise acceleration
	  measurement.
	  this config will turn on accelerometer feature.
```

## tct/Kconfig
```kconfig
config TCT_GFLIP6_VZW
        bool "TCT GFLIP6 VZW"
        default n
        help
          Support for TCT GFLip6 VZW device.

config TCT_GFLIP6_GC
        bool "TCT GFLIP6 GC"
        default n
        help
          Support for TCT GFLip6 GC device.
```
